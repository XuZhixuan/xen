## xen/arch/riscv/Kconfig.debug
```kconfig
config EARLY_PRINTK
    bool "Enable early printk"
    default DEBUG
    help
      Enables early printk debug messages

config DEBUG_FDT
		bool "Debug flattened device tree"
		default DEBUG
		help
		  Dump the device tree created for domains.
```

## xen/arch/riscv/configs/tiny64_defconfig
```kconfig
# CONFIG_SCHED_CREDIT is not set
# CONFIG_SCHED_RTDS is not set
# CONFIG_SCHED_NULL is not set
# CONFIG_SCHED_ARINC653 is not set
# CONFIG_TRACEBUFFER is not set
# CONFIG_HYPFS is not set
# CONFIG_GRANT_TABLE is not set
# CONFIG_SPECULATIVE_HARDEN_ARRAY is not set
# CONFIG_ARGO is not set
# CONFIG_HYPFS_CONFIG is not set
# CONFIG_CORE_PARKING is not set
# CONFIG_DEBUG_TRACE is not set
# CONFIG_IOREQ_SERVER is not set
# CONFIG_CRASH_DEBUG is not set
# CONFIG_GRANT_TABLE is not set
# CONFIG_HYPFS is not set
# CONFIG_KEXEC is not set
# CONFIG_LIVEPATCH is not set
# CONFIG_MEM_ACCESS is not set
# CONFIG_NUMA is not set
# CONFIG_PERF_COUNTERS is not set
# CONFIG_HAS_PMAP is not set
# CONFIG_TRACEBUFFER is not set
# CONFIG_XENOPROF is not set
# CONFIG_COMPAT is not set
# CONFIG_COVERAGE is not set
# CONFIG_UBSAN is not set
# CONFIG_NEEDS_LIBELF is not set
CONFIG_RISCV_64=y
CONFIG_DEBUG=y
CONFIG_DEBUG_INFO=y
CONFIG_EXPERT=y
CONFIG_HAS_NS16550=y
CONFIG_DEVICE_TREE_DEBUG=y
CONFIG_SCHED_NULL=y
CONFIG_BOOT_TIME_CPUPOOLS=y
CONFIG_HAS_DEVICE_TREE=y
CONFIG_USING_MSI=y
CONFIG_HAS_PCI=y
CONFIG_DEBUG_FDT=y
```

## xen/drivers/passthrough/riscv/Kconfig
```kconfig
config IOMMU_DEBUG
	bool "Debug mode"
	default false
	help
		Enables debug mode.

config IOMMU_CQ_ORDER
	int "Command queue size (power of 2 of one page size (4kiB))"
	range 0 8
	default 2
	help
		Command queue size (power of 2 of one page size (4kiB))
		Defaults and Examples:
			8 => 1 MiB    (65536 entries)
			7 => 512 KiB  (32768 entries)
			6 => 256 KiB  (16384 entries)
			5 => 128 kiB  (8192 entries)
			4 => 64 kiB   (4096 entries)
			3 => 32 kiB   (2048 entries)
			2 => 16 kiB   (1024 entries, default)
			1 => 8 kiB    (512 entries)
			0 => 4 kiB    (256 entries)
			
config IOMMU_FQ_ORDER
	int "Fault queue size (power of 2 of one page size (4kiB))"
	range 0 8
	default 2
	help
	  	Command queue size (power of 2 of one page size (4kiB))
	  	Defaults and Examples:
			8 => 1 MiB    (32768 entries)
			7 => 512 KiB  (16384 entries)
			6 => 256 KiB  (8192 entries)
			5 => 128 kiB  (4096 entries)
			4 => 64 kiB   (2048 entries)
			3 => 32 kiB   (1024 entries)
			2 => 16 kiB   (512 entries, default)
			1 => 8 kiB    (256 entries)
			0 => 4 kiB    (128 entries)

config IOMMU_PQ_ORDER
	int "Page request order (power of 2 of a page size (4kiB))"
	range 0 8
	default 2
	help
	  	Command queue size (power of 2 of one page size (4kiB))
	  	Defaults and Examples:
			8 => 1 MiB    (65536 entries)
			7 => 512 KiB  (32768 entries)
			6 => 256 KiB  (16384 entries)
			5 => 128 kiB  (8192 entries)
			4 => 64 kiB   (4096 entries)
			3 => 32 kiB   (2048 entries)
			2 => 16 kiB   (1024 entries, default)
			1 => 8 kiB    (512 entries)
			0 => 4 kiB    (256 entries)
```
